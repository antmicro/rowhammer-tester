## firmware/ddr5_tester/buildroot/configs/ddr5_vexriscv_defconfig
```kconfig
BR2_riscv=y
BR2_riscv_custom=y
BR2_RISCV_ISA_CUSTOM_RVM=y
BR2_RISCV_32=y
BR2_PACKAGE_HOST_LINUX_HEADERS_CUSTOM_5_11=y
BR2_ROOTFS_OVERLAY="$(BR2_EXTERNAL_DDR5_VEXRISCV_SMP_PATH)/board/ddr5_vexriscv_smp/rootfs_overlay"
BR2_LINUX_KERNEL=y
BR2_LINUX_KERNEL_CUSTOM_GIT=y
BR2_LINUX_KERNEL_CUSTOM_REPO_URL="https://github.com/antmicro/linux.git"
BR2_LINUX_KERNEL_CUSTOM_REPO_VERSION="472233ab29585c98fd2d861f01841b330fb14a81"
BR2_LINUX_KERNEL_USE_CUSTOM_CONFIG=y
BR2_LINUX_KERNEL_CUSTOM_CONFIG_FILE="$(BR2_EXTERNAL_DDR5_VEXRISCV_SMP_PATH)/board/ddr5_vexriscv_smp/linux.config"
BR2_LINUX_KERNEL_DTS_SUPPORT=y
BR2_LINUX_KERNEL_CUSTOM_DTS_PATH="$(BR2_EXTERNAL_DDR5_VEXRISCV_SMP_PATH)/board/ddr5_vexriscv_smp/rv32.dts"
BR2_TARGET_ROOTFS_CPIO=y
BR2_TARGET_OPENSBI=y
BR2_TARGET_OPENSBI_CUSTOM_GIT=y
BR2_TARGET_OPENSBI_CUSTOM_REPO_URL="https://github.com/litex-hub/opensbi.git"
BR2_TARGET_OPENSBI_CUSTOM_REPO_VERSION="1.3.1-linux-on-litex-vexriscv"
BR2_TARGET_OPENSBI_PLAT="litex/vexriscv"
# BR2_TARGET_OPENSBI_INSTALL_DYNAMIC_IMG is not set
BR2_PACKAGE_HOST_DOSFSTOOLS=y
BR2_PACKAGE_HOST_GENIMAGE=y
BR2_PACKAGE_HOST_MTOOLS=y
```

## firmware/zcu104/buildroot/Config.in
```kconfig
source "$BR2_EXTERNAL_ZCU104_ROW_HAMMER_PATH/package/zcu104_etherbone/Config.in"
```

## firmware/zcu104/buildroot/configs/zynqmp_zcu104_defconfig
```kconfig
# General
BR2_aarch64=y
BR2_GLOBAL_PATCH_DIR="$(BR2_EXTERNAL_ZCU104_ROW_HAMMER_PATH)/board/zynqmp/patches/"
BR2_ROOTFS_OVERLAY="$(BR2_EXTERNAL_ZCU104_ROW_HAMMER_PATH)/rootfs_overlay"
# BR2_ROOTFS_POST_IMAGE_SCRIPT="board/zynqmp/post-image.sh"
BR2_ROOTFS_POST_BUILD_SCRIPT="$(BR2_EXTERNAL_ZCU104_ROW_HAMMER_PATH)/post-build.sh"

# ARM Trusted Firmware
BR2_TARGET_ARM_TRUSTED_FIRMWARE=y
BR2_TARGET_ARM_TRUSTED_FIRMWARE_CUSTOM_GIT=y
BR2_TARGET_ARM_TRUSTED_FIRMWARE_CUSTOM_REPO_URL="https://github.com/Xilinx/arm-trusted-firmware.git"
# BR2_TARGET_ARM_TRUSTED_FIRMWARE_CUSTOM_REPO_VERSION="xilinx-v2020.1"
BR2_TARGET_ARM_TRUSTED_FIRMWARE_CUSTOM_REPO_VERSION="xlnx_rebase_v2.2"
BR2_TARGET_ARM_TRUSTED_FIRMWARE_PLATFORM="zynqmp"
BR2_TARGET_ARM_TRUSTED_FIRMWARE_BL31_UBOOT=y

# U-Boot
BR2_TARGET_UBOOT=y
BR2_TARGET_UBOOT_BUILD_SYSTEM_KCONFIG=y
BR2_TARGET_UBOOT_CUSTOM_GIT=y
BR2_TARGET_UBOOT_CUSTOM_REPO_URL="git://github.com/Xilinx/u-boot-xlnx.git"
# BR2_TARGET_UBOOT_CUSTOM_REPO_VERSION="xilinx-v2020.2"
# BR2_TARGET_UBOOT_BOARD_DEFCONFIG="xilinx_zynqmp_virt"
# BR2_TARGET_UBOOT_CUSTOM_REPO_VERSION="xilinx-v2019.2"
BR2_TARGET_UBOOT_CUSTOM_REPO_VERSION="xilinx-v2018.3"
BR2_TARGET_UBOOT_BOARD_DEFCONFIG="xilinx_zynqmp_zcu104_revC"
BR2_TARGET_UBOOT_NEEDS_DTC=y

# U-Boot SPL
# BR2_TARGET_UBOOT_SPL=y
BR2_TARGET_UBOOT_SPL_NAME="spl/boot.bin"
BR2_TARGET_UBOOT_ZYNQMP=y

# PMU Firmware
# BR2_TARGET_UBOOT_ZYNQMP_PMUFW="$(BR2_EXTERNAL_ZCU104_ROW_HAMMER_PATH)/pmufw.elf"
# BR2_TARGET_UBOOT_ZYNQMP_PMUFW="https://github.com/lucaceresoli/zynqmp-pmufw-binaries/raw/07b729ac4c968e14e38db9fa4dbae9550093b5c0/bin/pmufw-v2018.3.bin"
# BR2_TARGET_UBOOT_ZYNQMP_PM_CFG="$(BR2_EXTERNAL_ZCU104_ROW_HAMMER_PATH)/pm_cfg_obj.c"
# BR2_TARGET_UBOOT_ZYNQMP_PSU_INIT_FILE="$(BR2_EXTERNAL_ZCU104_ROW_HAMMER_PATH)/psu_init_gpl.c"

# Linux Kernel
BR2_LINUX_KERNEL=y
BR2_LINUX_KERNEL_CUSTOM_GIT=y
BR2_LINUX_KERNEL_CUSTOM_REPO_URL="git://github.com/Xilinx/linux-xlnx.git"
BR2_LINUX_KERNEL_CUSTOM_REPO_VERSION="xilinx-v2020.1"
BR2_LINUX_KERNEL_DEFCONFIG="xilinx_zynqmp"
BR2_LINUX_KERNEL_DTS_SUPPORT=y
BR2_LINUX_KERNEL_INTREE_DTS_NAME="xilinx/zynqmp-zcu104-revC"
BR2_PACKAGE_HOST_LINUX_HEADERS_CUSTOM_5_4=y

# RootFS
BR2_TARGET_ROOTFS_EXT2=y
BR2_TARGET_ROOTFS_EXT2_4=y
BR2_TARGET_ROOTFS_TAR=y
BR2_PACKAGE_HOST_DOSFSTOOLS=y
BR2_PACKAGE_HOST_GENIMAGE=y
BR2_PACKAGE_HOST_MTOOLS=y

# Network tools and SSH
BR2_PACKAGE_IPUTILS=y
BR2_PACKAGE_OPENSSH=y
BR2_PACKAGE_OPENSSH_CLIENT=y
BR2_PACKAGE_OPENSSH_SERVER=y
BR2_PACKAGE_OPENSSH_KEY_UTILS=y

# ZCU104 EtherBone firmware
BR2_PACKAGE_ZCU104_ETHERBONE=y
```

## firmware/zcu104/buildroot/package/zcu104_etherbone/Config.in
```kconfig
config BR2_PACKAGE_ZCU104_ETHERBONE
    bool "zcu104_etherbone"
    help
        EtherBone server to access PL memory over ZynqUS+ PS->PL AXI
```
